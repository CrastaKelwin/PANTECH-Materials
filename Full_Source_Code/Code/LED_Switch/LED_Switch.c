/***********************************************************************************************
;||||||||||||||||||||||||||||||||||||||||||||||||||||||||||||||||||||||||||||||||||||||||||||||;
;||||||||||||||||||||||||||||||||||||||||||||||||||||||||||||||||||||||||||||||||||||||||||||||;
;||~~~~~~~~~~~~~~~~~~~~~~~~~~~~~~~~~~~~	Important Note ~~~~~~~~~~~~~~~~~~~~~~~~~~~~~~~~~~~~~~||;
;||~																						~||;
;||~		This part of the software coding is the sole property of the company!			~||;
;||~		Any unauthorized re-usage or transformation of this code is prohibited.			~||;
;||~																						~||;
;||~				© Pantech Solutions Pvt Ltd. | All rights Reserved						~||;
;||~																						~||;
;||~~~~~~~~~~~~~~~~~~~~~~~~~~~~~~~~~~~~~~~~~~~~~~~~~~~~~~~~~~~~~~~~~~~~~~~~~~~~~~~~~~~~~~~~~~||;
;||~~~~~~~~~~~~~~~~~~~~~~~~~~~~~~~~~~~~~~~~~~~~~~~~~~~~~~~~~~~~~~~~~~~~~~~~~~~~~~~~~~~~~~~~~~||;
;||||||||||||||||||||||||||||||||||||||||||||||||||||||||||||||||||||||||||||||||||||||||||||||;
;||||||||||||||||||||||||||||||||||||||||||||||||||||||||||||||||||||||||||||||||||||||||||||||;
;||	Title		: LED_Switch 																	 ||;
;||	Status		: Completed!																 ||;
;||	Features	: LED Demonstraction and DIP Switch Interface using ADD ON Cards			 ||;
;||	Description	: Switch		:   P0.8 - P0.15      										 ||;
;||				  LED Port 		:   P1.16 - P1.23         									 ||;
;||																							 ||;
;||||||||||||||||||||||||||||||||||||||||||||||||||||||||||||||||||||||||||||||||||||||||||||||;
;||||||||||||||||||||||||||||||||||||||||||||||||||||||||||||||||||||||||||||||||||||||||||||||;
/***********************************************************************************************/

//<<<<<<<<<<<<<<<<<<<<<<<<<<<<<<<<<<<	Code Begins Here	>>>>>>>>>>>>>>>>>>>>>>>>>>>>>>>>>>>>

#include <LPC214x.h>
#include <stdio.h>

#define LED 	16
#define Switch	8


/*************************************     Declarations     ************************************/

void Delay(int);
/***********************************************************************************************/


int main(void)
{
	unsigned char Status=1;
	PINSEL0 = 0;
	PINSEL2	&= 	0xFFFFFFF3;				//Configure P1.16 - P1.31 as GPIO

	IO0DIR	=	0x00 << Switch;			//Configure P0.8 - P0.15 as Input
	IO1DIR	|=	0xFF << LED;			//Configure P1.16 - P1.23 as Output


	while(1)
	{
		Status = 1;
		IOSET1	=	0xFF << LED;
		Delay (10);Delay (10);Delay (10);
		IOCLR1	=	0xFF << LED;		
		Delay (10);Delay (10);Delay (10);
		
		while (~Status)
		{
			Status 	= 	((IO0PIN & (0xFF << Switch)) >> Switch);
			IO1PIN	=	((~Status) << LED);
		}
	
	}
}

void Delay(int n)
{
	int p,q;

	for(p=0;p<n;p++)
	{
		for(q=0;q<0x9990;q++);
	}
}


